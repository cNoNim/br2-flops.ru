## configs/flops.ru_defconfig
```kconfig
BR2_x86_64=y
BR2_x86_corei7=y
BR2_GLOBAL_PATCH_DIR="$(BR2_EXTERNAL)/board/cnonim.name/flops.ru/patches"
BR2_TOOLCHAIN_BUILDROOT_VENDOR="cnonim"
BR2_TOOLCHAIN_BUILDROOT_LOCALE=y
BR2_BINUTILS_VERSION_2_25=y
BR2_GCC_VERSION_4_9_X=y
BR2_ENABLE_LOCALE_PURGE=y
BR2_ENABLE_LOCALE_WHITELIST="C en_US ru_RU"
BR2_GENERATE_LOCALE="en_US ru_RU"
BR2_TARGET_OPTIMIZATION="-march=corei7-avx -fomit-frame-pointer -pipe"
BR2_TARGET_GENERIC_HOSTNAME="cnonim.name"
BR2_TARGET_GENERIC_ISSUE=""
BR2_TARGET_GENERIC_PASSWD_SHA256=y
BR2_TARGET_GENERIC_GETTY_PORT="ttyS0"
BR2_TARGET_GENERIC_GETTY_BAUDRATE_9600=y
BR2_TARGET_GENERIC_GETTY_TERM="vt220"
BR2_TARGET_TZ_INFO=y
BR2_TARGET_TZ_ZONELIST="europe"
BR2_TARGET_LOCALTIME="Europe/Moscow"
BR2_ROOTFS_OVERLAY="$(BR2_EXTERNAL)/board/cnonim.name/flops.ru/rootfs-overlay"
BR2_LINUX_KERNEL=y
BR2_LINUX_KERNEL_USE_CUSTOM_CONFIG=y
BR2_LINUX_KERNEL_CUSTOM_CONFIG_FILE="$(BR2_EXTERNAL)/board/cnonim.name/flops.ru/linux-3.19.3.config"
BR2_LINUX_KERNEL_INSTALL_TARGET=y
BR2_PACKAGE_E2FSPROGS=y
BR2_PACKAGE_DROPBEAR=y
BR2_TARGET_ROOTFS_CPIO=y
BR2_TARGET_ROOTFS_CPIO_GZIP=y
```
